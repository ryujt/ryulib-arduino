#ifndef SERVOCONTROL_H
#define SERVOCONTROL_H


#include <Arduino.h>
#include <Servo.h>


#define SPEED 20


const unsigned char pattern_1[1026] PROGMEM = { 0x06, 0x07, 0x07, 0x07, 0x07, 0x07, 0x08, 0x07, 0x08, 0x07, 0x09, 0x07, 0x09,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 0x07, 0x08 };
const unsigned char pattern_2[1158] PROGMEM = { 0x51, 0x09, 0x51, 0x09, 0x50, 0x09, 0x4F, 0x09, 0x4E, 0x09, 0x4E, 0x09, 0x4D,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 0x4B, 0x0A };
const unsigned char pattern_3[1060] PROGMEM = { 0x19, 0x0D, 0x19, 0x0D, 0x19, 0x0F, 0x19, 0x10, 0x19, 0x11, 0x19, 0x13, 0x19,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 0x19, 0x0E };


class ServoControl
{
private:
	int pin_x_;
	int pin_y_;
	Servo servo_x_;
	Servo servo_y_;

	int no_;
	int index_;
	bool is_attached_;
	bool is_started_;
	long old_tick_;
	int count_;

public:
	ServoControl(int pin_x, int pin_y)
		: pin_x_(pin_x), pin_y_(pin_y), servo_x_(), servo_y_(),
		  no_(1), index_(0), is_attached_(false), is_started_(false), old_tick_(0), count_(0)
	{
	}

	void attach()
	{
    	if (is_attached_) return;

    	is_attached_ = true;

		servo_x_.attach(pin_x_);
		servo_y_.attach(pin_y_);
	}

	void detach()
	{
    	is_attached_ = false;

		servo_x_.detach();
		servo_y_.detach();
	}

	void start(int no)
	{
    	no_ = no;
		is_started_ = true;
		old_tick_ = 0;

    	attach();
	}

	void stop()
	{
		is_started_ = false;
    	detach();
	}

 	void gotoXY(int x, int y)
	{
		is_started_ = false;
		attach();
		servo_x_.write(x);
		servo_y_.write(y);
	}

  void execute(String cmd)
  {
      char *text = (char *) cmd.c_str();
      char *str[6];
      for (int i=0; i<6; i++) {
        str[i] = strtok_r(text, " ", &text);
      }

      String str_x = str[1];
      String str_y = str[2];

      int x = str_x.toInt();
      int y = str_y.toInt();

      gotoXY(x, y);
  }
  
	void execute(char ch)
	{
		switch (ch) {
			case 'A': start(1); break;
			case 'B': start(2); break;
			case 'C': start(3); break;
			case 'S': stop(); break;
		}

		if (is_started_ == false) return;

		long tick = millis();
		long term;
		if ((tick > old_tick_) && (old_tick_ != 0)) count_ = count_ + (tick - old_tick_);
		old_tick_ = tick;

		if (count_ < SPEED) return;
		count_ = 0;

	    int size;
	    switch (no_) {
			case 1: size = sizeof(pattern_1) / 2; break;
			case 2: size = sizeof(pattern_2) / 2; break;
			case 3: size = sizeof(pattern_3) / 2; break;
    	}

	    if (index_ >= size) index_ = 0;

	    int x;
	    int y;
	    switch (no_) {
			case 1: {
				x = pgm_read_byte(&pattern_1[index_ * 2]);
				y = pgm_read_byte(&pattern_1[(index_ * 2) + 1]);
			} break;

			case 2: {
				x = pgm_read_byte(&pattern_2[index_ * 2]);
				y = pgm_read_byte(&pattern_2[(index_ * 2) + 1]);
			} break;

			case 3: {
				x = pgm_read_byte(&pattern_3[index_ * 2]);
				y = pgm_read_byte(&pattern_3[(index_ * 2) + 1]);
			} break;
	    }

	    servo_x_.write(x);
	    servo_y_.write(y);

	    index_++;
	}
};


#endif // SERVOCONTROL_H
